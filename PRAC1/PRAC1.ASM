;PRACTICA1
DATOA		EQU			0X20
DATOB		EQU			0X21
DATOD		EQU			0X22
CNT			EQU			0X23
RESB		EQU			0X24

			INCLUDE		<D:\dtrej\Documents\Escuela\Micros\PROGRAMAS\ENCABEZADO\ENCABEZADO.ASM> ;B1
			CLRF		TRISC		;COLOCAMOS COMO SALIDA EL PUERTO C.
			BCF			TRISB,7		;COLOCAMOS EL BIT 7 DEL PUERTO B COMO SALIDA.
			BCF			STATUS,RP0	;B0.

INICIO		BTFSS		PORTB,0		;SE ACTIVO EL PUSH DE B0?.
			GOTO		INICIO		;PERMANECE EN INICIO HASTA QUE SE ACTIVE.
			MOVF		PORTD,W		;CARGA EL VALOR DE D A W.
			MOVWF		DATOA		;GUARDA EL VALOR 1 EN DATOA.
			MOVWF		PORTC		;MUESTRA EL VALOR 1 EN EL PUERTOC.

PUSHES		BTFSC		PORTB,1		;EL PUSH1  ESTA ACTIVADO?
			GOTO		SUMA		;SI EL PUSH1 ESTA ACTIVADO VA A LA SUMA
			BTFSC		PORTB,2		;EL PUSH2 ESTA ACTIVO?
			GOTO		RESTA		;SI EL PUSH2 ESTA ACTIVADO VA A LA RESTA
			BTFSC		PORTB,3		;EL PUSH3 ESTA ACTIVO?
			GOTO		MULTI		;SI EL PUSH3 ESTA ACTIVADO VA A LA MULTIPLICACION
			GOTO		PUSHES		;SI NINGUNO DE LOS PUSHES SE ACTIVO ENTRA EN BUCLE HASTA QUE UNO SE ACTIVE

SUMA		MOVF		PORTD,W		;LEE EL CONTENIDO DEL PUERTOD.
			MOVWF		DATOB		;CARGA EL VALOR DEL PORTD EN EL DATO B
			ADDWF		DATOA,W		;SUMA 	DATA1 + DATO2.
			MOVWF		PORTC		;MUESTRA EL RESULTADO EN EL PORTC.
			BTFSC		STATUS,C	;GENERO ACARREO?
			BSF			PORTB,7		;ENCIENDE EL LED CONECTADO AL PORTB7.
			GOTO		DIV			;VE A DIV.			

RESTA		MOVF		PORTD,W		;LEE EL CONTENIDO DEL PORTD.
			MOVWF		DATOB		;CARGA EL VALOR DEL PORTD EN EL DATO B
			SUBWF		DATOA,W		;RESTA REG20 - PORTD(DATO2)
			BTFSS		STATUS,C	;EL RESULTADO ES POSITIVO?
			SUBLW		0X00		;OBTEN EL COMPLEMENTO A2.
			MOVWF		PORTC		;MUESTRA LA MAGNITUD DE EL RESULTADO EN EL PUERTOC.
			BTFSS		STATUS,C	;EL RESULTADO ES POSITIVO?
			BSF			PORTB,7		;ENCIENDE EL LED DEL PORTB.7.
			GOTO		DIV

MULTI		MOVF		PORTD,W		;LEE EL CONTENIDO DEL PORTD.
			MOVF		PORTD,W		;CARGA EL CONTENIDO DEL PORTD EN W
			MOVWF		DATOB		;VALOR2 B	
			MOVWF		RESB		;CARGAMOS OTRA VEZ EL VALOR B
			CLRF		DATOD		;VALOR D
			MOVLW		0XFF		;CARGAMOS A W CON 0XFF
			ANDWF		DATOA,W		;PROBAMOS SI A==0 HACIENDO LA OPERACION AND EN A
			BTFSS		STATUS,Z	;PREGUNTAMOS Z==1 EN CASO DE SERLO SIGNIFICA QUE A==0
			GOTO		TESTB		;EN CASO DE NO SERLO VAMOS A PROBAR A B
			MOVLW		0X00		;EN CASO DE SI SERLO CARGAMOS CON 0 A W
			MOVWF		PORTC		;CARGAMOS A W CON 0
			GOTO		DIV			

TESTB		MOVLW		0XFF		;CARGAMOS A W CON 0XFF
			ANDWF		DATOB,W		;PROBAMOS SI B=0 HACIENDO LA OPERACION AND EN B
			BTFSS		STATUS,Z	;PREGUNTAMOS SI Z==1 EN CASO DE SERLO SIGNIFICA QUE B==0
			GOTO		BUCLE		;EN CASO DE NO SERLO VAMOS A HACER LA MULTIPLICACION
			MOVLW		0X00		;EN CASO DE SI SERLO CARGAMOS CON 0 A W
			MOVWF		PORTC		;CARGAMOS A W CON 0
			GOTO		DIV
			
BUCLE		MOVF		DATOA,W	;LEEO A Y LO CARGO EN W 
			ADDWF		DATOD,F	;HACEMOS LA OPERACION D=D+W PERO W=A
			BTFSC		STATUS,C ;PREGUNTAMOS SI HUBO ACARREO LO QUE SIGNIFICARIA QUE EXCEDIMOS LOS BITS
			BSF			PORTB,7	; EN CASO DE SI SERLO COLOCAMOS AL PORTB.7 CON 1
			DECFSZ		RESB,F	;DECREMENTAMOS A B Y PREGUNTAMOS SI YA LLEGO A 0
			GOTO		BUCLE	;EN CASO DE NO HABER LLEGADO REGRESAMOS AL BUCLE
			MOVF		DATOD,W	;EN CASO DE HABER LLEGADO A 0 CARGAMOS A W CON D
			MOVWF		PORTC	;CARGAMOS AL PORTC CON D
			GOTO		DIV
			
DIV			BTFSS		PORTB,0	;SE VOLVIO A ACTIVAR EL BOTON DEL B0?
			GOTO		DIV		;ESPERA A QUE SE ACTIVE EL PUSH DE B0.			
			BCF			PORTB,7	;COLOCAMOS EL PORTB.7 EN 0 EN CASO DE QUE SE HAYA ENCENDIDO EN ALGUNA DE LAS OPERACIONES ANTERIORES			
			CLRF		CNT		;PONEMOS EN 0 EL CONTADOR 
			MOVLW		0XFF	;CARGAMOS 0XFF A W
			ANDWF		DATOB,W	;HACEMOS LA OPERACION LOGICA AND A EL DATO B CON RESPECTO A W
			BTFSS		STATUS,Z	;PROBAMOS LA BANDERA Z PARA SABER SI EL REULTADO ES 0
			GOTO		TESTDIVA	; EN CASO DE NO SERLO VAMOS A HACER LA DIVICION
			MOVLW		0XFF	;EN CASO DE QUE B SEA 0 CARGAMOS A W CON 0XFF
			MOVWF		PORTC	;CARGAMOS AL PUERTO C CON EL CONTENIDO DE W
			BSF			PORTB,7	;ENCENDEMOS EL LED CONECTADO AL PORTB.7
			GOTO		$

TESTDIVA	MOVLW		0XFF	;CARGAMOS 0XFF A W
			ANDWF		DATOA,W	;HACEMOS LA OPERACION LOGICA AND A EL DATO A CON RESPECTO A W
			BTFSS		STATUS,Z	;PROBAMOS LA BANDERA Z PARA SABER SI EL RESULTADO ES 0
			GOTO		DIVA	;SI NO ES 0 VAMOS A PROBAR EL DATO B
			MOVF		CNT,W	;EN CASO DE SER 0 EL RESULTADO CARGAMOS EL CONTENIDO DEL CONTADOR A W
			MOVWF		PORTC	;CARGAMOS AL PORT C CON W
			GOTO		$

DIVA		INCF		CNT,F	;CNT=CNT+1
			MOVF		DATOB,W	;CARGAMOS EL CONTENIDO QUE HAY EN EL DATOB QUE EXTRAJIMOS EN LAS OPERACIONES ANTERIORES
			SUBWF		DATOA,F	;HACEMOS LA RESTA DE A-B Y LO CARGAMOS EN A
			BTFSC		STATUS,C	;PREGUNTAMOS SI A>=B
			GOTO		DIVA	;SI A>=B CONTINUAMOS HACIENDO RESTAS EN BUCLE
			MOVF		DATOB,W	;CARGAMOS EL DATO B A W
			ADDWF		DATOA,F	;SUMAMOS A+B
			MOVLW		0XFF	;CARGAMOS A W CON 0XFF
			ANDWF		DATOA,F	;HACEMOS LA OPERACION LOGICA AND A EL DATO A CON RESPECTO W PARA CONOCER SI ES CERO
			BTFSS		STATUS,Z	;PREGUNTAMOS SI NUESTRA OPERACION DIO 0 COMO RESULTADO
			BSF			PORTB,7	;EN CASO DE NO HABER DADO 0 SIGNIFICA QUE HAY RESIDUO
			DECF		CNT,F	;DECREMENTAMOS EN 1 EL CONTADOR
			MOVF		CNT,W	;CARGAMOS EL CONTENIDO DEL CONTADOR A W
			MOVWF		PORTC	;MUESTRA EL RESULTADO EN EL PORTC.	
			GOTO 		$
			END
			
;PRACTICA1
			INCLUDE		<D:\dtrej\Documents\Escuela\Micros\PROGRAMAS\ENCABEZADO.ASM> ;B1
			CLRF		TRISC
			BCF			TRISB,7
			BCF			STATUS,RP0	;B0

INICIO		BTFSS		PORTB,0
			GOTO		INICIO
			MOVF		PORTD,W
			MOVWF		0X20	;VALOR1 O A
			MOVWF		PORTC

PUSH		BTFSS		PORTB,3
			GOTO		PUSH
			MOVF		PORTD,W
			MOVWF		0X21	;VALOR2 B	
			CLRF		0X22	;VALOR D
		
			MOVLW		0XFF
			ANDWF		0X20,W	;PROBAMOS SI A==0
			BTFSS		STATUS,Z
			GOTO		TESTB
			MOVLW		0X00
			MOVWF		PORTC
			GOTO		$

TESTB		MOVLW		0XFF
			ANDWF		0X21,W	;PROBAMOS SI B=0
			BTFSS		STATUS,Z
			GOTO		BUCLE
			MOVLW		0X00
			MOVWF		PORTC
			GOTO		$
			
BUCLE		MOVF		0X20,W	;LEEO A 
			ADDWF		0X22,F	;D=D+A
			DECFSZ		0X21,F	;B
			GOTO		BUCLE		
			MOVF		0X22,W
			MOVWF		PORTC
			BTFSC		STATUS,C
			BSF			PORTB,7
			GOTO		$


			END
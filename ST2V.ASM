;SUBRUTINA DE TIEMPO DE 2 VARIABLES A 200000uS
;ECUACION	7+(4)(VAR2)+(#NOPS+3)*VAR1*VAR2
			INCLUDE		<D:\dtrej\Documents\Escuela\Micros\PROGRAMAS\ENCABEZADO.ASM>		;B1
			CLRF		TRISD
			BCF			STATUS,RP0		;B0
INICIO:		COMF		PORTD,F
			
			MOVLW		.180	;VAR2	
			MOVWF		0X61
			MOVLW		.158	;VAR1
			MOVWF		0X62		
			CALL		ST2V
			MOVLW		.26		;VAR11
			MOVWF		0X60
			CALL		ST2V
			NOP
			NOP
			NOP
			NOP
			NOP
			NOP
			GOTO		INICIO

ST2V:		MOVF		0X62,W
			MOVWF		0X63
DECRE2V:	NOP
			NOP
			NOP
			NOP
			DECFSZ		0X63,F
			GOTO		DECRE2V
			DECFSZ		0X61,F
			GOTO		ST2V
			RETURN

ST1V:		NOP
			NOP
			NOP
			NOP
			DECFSZ		0X60,F
			GOTO		ST1V
			RETURN

			END
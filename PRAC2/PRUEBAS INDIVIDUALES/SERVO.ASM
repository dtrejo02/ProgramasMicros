			INCLUDE		<D:\dtrej\Documents\Escuela\Micros\PROGRAMAS\ENCABEZADO\ENCABEZADO.ASM> ;B1
			CLRF		TRISC		;COLOCAMOS COMO SALIDA EL PUERTO C.
			BCF			TRISB,7		;COLOCAMOS EL BIT 7 DEL PUERTO B COMO SALIDA.
			BCF			TRISB,4		;COLOCAMOS EL BIT 4 DEL PUERTO B COMO SALIDA PARA EL SERVO
			BCF			STATUS,RP0	;B0.
			
PUSHES:		BTFSC		PORTB,1		;EL PUSH1  ESTA ACTIVADO?
			GOTO		G45			;SI EL PUSH1 ESTA ACTIVADO VA A LA SUMA
			BTFSC		PORTB,2		;EL PUSH2 ESTA ACTIVO?
			GOTO		G90			;SI EL PUSH2 ESTA ACTIVADO VA A LA RESTA
			BTFSC		PORTB,3		;EL PUSH3 ESTA ACTIVO?
			GOTO		G135		;SI EL PUSH3 ESTA ACTIVADO VA A LA MULTIPLICACION
			GOTO		PUSHES		;SI NINGUNO DE LOS PUSHES SE ACTIVO ENTRA EN BUCLE HASTA QUE UNO SE ACTIVE
			
G45:		PUSHMAC		PORTB,1
GD45:		BSF			PORTB,4
			SUBT1V		.35
			BCF			PORTB,4
			SUBT3V		.1,.65,.43
			GOTO		GD45

G90:		PUSHMAC		PORTB,2
GD90:		BSF			PORTB,4
			SUBT3V		.1,.69,.1
			BCF			PORTB,4
			SUBT3V		.3,.21,.43
			GOTO		GD90

G135:		PUSHMAC		PORTB,3
GD135:		BSF			PORTB,4
			SUBT3V		.1,.1,.67
			BCF			PORTB,4
			SUBT3V		.10,.4,.60
			NOP
			GOTO		GD135

			INCLUDE		<D:\dtrej\Documents\Escuela\Micros\PROGRAMAS\VIDEOS\SUBRUTINAS\SUBRUTINASDETIEMPO.ASM>
			SUBT25MS
			END
;PORTD = PWM F=1000Hz cada que se apriete a PE.0 cambiar el PWMde:
;a) 0% al 5%
;b) 5% al 20%
;c) 20% al 50%
;d) 50% al 80%
;e) 20% al 100%
;MOSTRAR PE2= PARA COMPARAR CON EL PWM


			INCLUDE		<D:\dtrej\Documents\Escuela\Micros\PROGRAMAS\ENCABEZADO\ENCABEZADO.ASM>
			CLRF		TRISD
			BCF			TRISE,2
			BCF			STATUS,RP0
			
INICIO:		BSF			PORTE,2
PWM5:		CALL		TESTPE0
			SUBT3V		.1,.2,.2
			COMF		PORTD,F
			SUBT2V		.9,.14
			NOP
			BTFSS		PORTE,0
			GOTO		PWM5
			CALL		TESTPE0

PWM20:		COMF		PORTD,F
			SUBT2V		.4,.6
			COMF		PORTD,F
			SUBT2V		.37,.3
			BTFSS		PORTE,0
			GOTO		PWM20
			CALL		TESTPE0

PWM50:		COMF		PORTD,F
			SUBT2V		.17,.4
			COMF		PORTD,F
			SUBT1V		.70
			NOP
			BTFSS		PORTE,0
			GOTO		PWM50
			CALL		TESTPE0

PWM80:		COMF		PORTD,F
			SUBT2V		.1,.72
			COMF		PORTD,F
			SUBT1V		.27
			NOP
			NOP
			BTFSS		PORTE,0
			GOTO		PWM80
			CALL		TESTPE0
			CLRF		PORTD
			GOTO		INICIO

TESTPE0:	PUSHMAC		PORTE,0
			RETURN
		
			INCLUDE		<D:\dtrej\Documents\Escuela\Micros\PROGRAMAS\VIDEOS\SUBRUTINAS\SUBRUTINASDETIEMPO.ASM>
			SUBT25MS
			END
			
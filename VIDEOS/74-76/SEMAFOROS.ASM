;MOSTRAR DOS SEMAFOROS
			INCLUDE		<D:\dtrej\Documents\Escuela\Micros\PROGRAMAS\VIDEOS\74-76\DEF_SEMAFORO.ASM>
			INCLUDE		<D:\dtrej\Documents\Escuela\Micros\PROGRAMAS\ENCABEZADO\ENCABEZADO.ASM>
		
			MOVLW		B'11111000'
			MOVWF		TRISD
			MOVWF		TRISE
			BCF			STATUS,RP0

INICIO		R1_A
			V1_E
			R2_E
			CALL		T30S
			V1_A

			MOVLW		.5
			MOVWF		0X20

PARP1:		A1_E
			CALL		T600MS
			A1_A
			CALL		T600MS
			DECFSZ		0X20,F
			GOTO		PARP1

			R2_A
			V2_E
			R1_E
			CALL		T30S
			V2_A

			MOVLW		.5
			MOVWF		0X20

PARP2:		A2_E
			CALL		T600MS
			A2_A
			CALL		T600MS
			DECFSZ		0X20,F
			GOTO		PARP2
			GOTO		INICIO

T600MS:		SUBT3V		.7,.49,.247
			RETURN

T30S:		SUBT3V		.211,.211,.96
			RETURN
			
			INCLUDE		<D:\dtrej\Documents\Escuela\Micros\PROGRAMAS\VIDEOS\SUBRUTINAS\SUBRUTINASDETIEMPO.ASM>
			;SUBT25MS
			END
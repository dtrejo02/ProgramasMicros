;QUE HAGA UNA SECUENCIA DE SONIDOS, CAMBIANDO DE SONIDO CADA QUE SE APRIETE UN INTERRUPTOR CONECTADO AL PE.0
;EL SONIDO DEBE SALIR POR PE.1
;LAS FRECUENCIAS SON: 330HZ (T/2=1515us)
;262 HZ (T/2=1908us), 392Hz Y 192 HZ

			INCLUDE		<D:\dtrej\Documents\Escuela\Micros\PROGRAMAS\ENCABEZADO\ENCABEZADO.ASM>
			BCF			TRISE,1
			BCF			STATUS,RP0
		
INICIO		CALL		F1			
			PUSHMAC		PORTE,0

			CALL		F1			
			PUSHMAC		PORTE,0

			CALL		F1			
			PUSHMAC		PORTE,0

F3:			BSF			PORTE,1
			SUBT2V		.3,.76
			BCF			PORTE,1
			SUBT3V		.5,.13,.15
			BTFSS		PORTE,0
			GOTO		F3
			PUSHMAC		PORTE,0
			CALL		F1
			PUSHMAC		PORTE,0

F4:			BSF			PORTE,1
			SUBT3V		.5,.35,.1
			BCF			PORTE,1
			SUBT3V		.1,.10,.17
			BTFSS		PORTE,0
			GOTO		F4
			PUSHMAC		PORTE,0

F5:			BSF			PORTE,1
			SUBT2V		.1,.236
			BCF			PORTE,1
			SUBT2V		.2,.144
			NOP
			BTFSS		PORTE,0	
			GOTO		F5
			GOTO		INICIO	

F1:			BSF			PORTE,1
			SUBT2V		.1,.137
			BCF			PORTE,1
			SUBT2V		.4,.47
			BTFSS		PORTE,0
			GOTO		F1
			RETURN
			

T25MS:		SUBT3V		.3,.47,.25
			RETURN


			INCLUDE		<D:\dtrej\Documents\Escuela\Micros\PROGRAMAS\VIDEOS\SUBRUTINAS\SUBRUTINASDETIEMPO.ASM>
			END
;SUBRUTINA DE TIEMPO DE 3 VARIABLES A 100000uS
;ECUACION:	#CM=9+(4)(VAR1)(1+VAR3)+VAR1*VAR2*VAR3*(#NOPS+3)
			INCLUDE		<D:\dtrej\Documents\Escuela\Micros\PROGRAMAS\ENCABEZADO.ASM>		;B1
			CLRF		TRISD
			BCF			STATUS,RP0		;B0
INICIO:		COMF		PORTD,F
			
			MOVLW		.198	;VAR1	
			MOVWF		0X64
			MOVLW		.71		;VAR2
			MOVWF		0X65		
			MOVLW		.1		;VAR3
			MOVWF		0X66
			CALL		ST3V
			NOP
			GOTO		INICIO

ST3V:		MOVF		0X66,W
			MOVWF		0X67
RECARGA3V:	MOVF		0X65,W
			MOVWF		0X68
DECRE3V		NOP
			NOP
			NOP
			NOP
			DECFSZ		0X68,F
			GOTO		DECRE3V
			DECFSZ		0X67,F
			GOTO		RECARGA3V
			DECFSZ		0X64,F
			GOTO		ST3V
			RETURN

			END
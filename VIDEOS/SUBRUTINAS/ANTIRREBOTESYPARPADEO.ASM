;OSCILACION EMPIEZA DESDE QUE SE APRIETE EL INTERRUPTOR CONECTADO A PE.0
;QUE SAQUE 0XF0 POR EL PD DURANTE 200ms
;QUE SAQUE 0X0F POR EL PD DURANTE 200ms
;QUE SE REPITA LA TAREA INDEFINIDAMENTE		
			INCLUDE		<D:\dtrej\Documents\Escuela\Micros\PROGRAMAS\ENCABEZADO.ASM>		;B1
			CLRF		TRISD
			BCF			STATUS,RP0		;B0
			
			BTFSS		PORTE,0
			GOTO		$-1
			CALL		T25MS
			BTFSC		PORTE,0
			GOTO		$-1
			CALL		T25MS
			
			MOVLW		0XF0
			MOVWF		PORTD
			CALL		T200MS
			SWAPF		PORTD,F
			GOTO		$-2

T25MS		MOVLW		.3	;VAR1	
			MOVWF		0X64
			MOVLW		.47		;VAR2
			MOVWF		0X65		
			MOVLW		.25		;VAR3
			MOVWF		0X66
			CALL		ST3V
			RETURN

T400MS:		MOVLW		.243	;VAR2	
			MOVWF		0X61
			MOVLW		.117	;VAR1
			MOVWF		0X62		
			CALL		ST2V
			RETURN

			INCLUDE		<D:\dtrej\Documents\Escuela\Micros\PROGRAMAS\SUBRUTINASDETIEMPO.ASM>

			END
			
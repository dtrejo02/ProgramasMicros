;PRACTICA1
			INCLUDE		<D:\dtrej\Documents\Escuela\Micros\PROGRAMAS\ENCABEZADO.ASM> ;B1
			CLRF			TRISC		;COLOCAMOS COMO SALIDA EL PUERTO C.
			BCF			TRISB,7		;COLOCAMOS EL BIT 7 DEL PUERTO B COMO SALIDA.
			BCF			STATUS,RP0	;B0.

INICIO		BTFSS		PORTB,0		;SE ACTIVO EL PUSH DE B0?.
			GOTO		INICIO		;PERMANECE EN INICIO HASTA QUE SE ACTIVE.
			MOVF		PORTD,W		;CARGA EL VALOR DE D A W.
			MOVWF		0X20		;GUARDA EL VALOR 1 EN REGISTRO 20.
			MOVWF		PORTC		;MUESTRA EL VALOR 1 EN EL PUERTOC.

PUSH1		BTFSC		PORTB,1		;EL PUSH1  ESTA ACTIVADO?
			GOTO		PUSH2		;VE A PUSH2
			MOVF		PORTD		;LEE EL CONTENIDO DEL PUERTOD.
			ADDWF		0X20,W		;SUMA 	DATA1 + DATO2.
			MOVWF		PORTC		;MUESTRA EL RESULTADO EN EL PORTC.
			BTFSS		STATUS,C		;GENERO ACARREO?
			BCF			PORTB,7		;APAGA EL LED CONECTADO AL PORTB7.
			GOTO		PUSH1		;VE A PUSH1.			
			BSF			PORTB,7		;ENCIENDE EL LED CONECTADO AL PORTB7.
			GOTO		PUSH1		;VE A PUSH1



PUSH2		BTFSS		PORTB,2		;EL PUSH 2 ESTA ACTIVADO?
			GOTO		PUSH3		;VE AL PUSH3
			MOVF		PORTD,W		;LEE EL CONTENIDO DEL PORTD.
			SUBWF		0X20,W		;RESTA REG20 - PORTD(DATO2)
			BTFSS		STATUS,C		;EL RESULTADO ES POSITIVO?
			SUBLW		0X00		;OBTEN EL COMPLEMENTO A2.
			MOVWF		PORTC		;MUESTRA LA MAGNITUD DE EL RESULTADO EN EL PUERTOC.
			BTFSS		STATUS,C		;EL RESULTADO ES POSITIVO?
			BSF			PORTB,7		;ENCIENDE EL LED DEL PORTB.7.
			GOTO		;ALO

PUSH3		BTFSS		PORTB,3		;EL PUSH3 ESTA ACTIVADO?
			GOTO		INCIO		;VUELVE A LEER LOS PUSH
			MOVF		PORTD,W		;LEE EL CONTENIDO DEL PORTD.
			MOVF		PORTD,W
			MOVWF		0X21		;VALOR2 B	
			CLRF			0X22		;VALOR D
			MOVLW		0XFF
			ANDWF		0X20,W		;PROBAMOS SI A==0
			BTFSS		STATUS,Z
			GOTO		TESTB
			MOVLW		0X00
			MOVWF		PORTC
			GOTO		$

TESTB		MOVLW		0XFF
			ANDWF		0X21,W		;PROBAMOS SI B=0
			BTFSS		STATUS,Z
			GOTO		BUCLE
			MOVLW		0X00
			MOVWF		PORTC
			GOTO		$
			
BUCLE		MOVF		0X20,W	;LEEO A 
			ADDWF		0X22,F	;D=D+A
			DECFSZ		0X21,F	;B
			GOTO		BUCLE		
			MOVF		0X22,W
			MOVWF		PORTC
			BTFSC		STATUS,C
			BSF			PORTB,7
			GOTO		$
			
PUSH0		BTFSS		PORTB,0		;SE VOLVIO A ACTIVAR EL BOTON DEL B0?
			GOTO		PUSH0		;ESPERA A QUE SE ACTIVE EL PUSH DE B0.			
			MOVF		PORTD,W		;LEE EL CONTENIDO DEL PUERTOD(DATO2).
			MOVWF		0X21		;VALOR2 O B
			CLRF			0X22		;CONTADOR CNT

			MOVLW		0XFF
			ANDWF		0X20,W
			BTFSS		STATUS,Z
			GOTO		TESTDIVB
			MOVF		0X22,W
			MOVWF		PORTC
			GOTO		$

TESTDIVB		MOVLW		0XFF
			ANDWF		0X21,W
			BTFSS		STATUS,Z
			GOTO		DIVA
			MOVLW		0XFF
			MOVWF		PORTC
			BSF			PORTB,7
			GOTO		$

DIVA			INCF			0X22,F	;CNT=CNT+1
			MOVF		0X21,W	;B
			SUBWF		0X20,F	;A=A-W PERO W=B
			BTFSS		STATUS,C	
			GOTO		DIVA
			BTFSS		STATUS,Z
			BSF			PORTB,7	
			MOVWF		PORTC	;MUESTRA EL RESULTADO EN EL PORTC.	
			GOTO 		$
			END
			